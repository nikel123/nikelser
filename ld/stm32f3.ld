/*
 * (c) Andrej Gelenberg <andrej.gelenberg@udo.edu> 2013-2016
 */

INCLUDE arm_cm4.ld

FLASH_BASE    = 0x40022000;
FLASH_ACR     = FLASH_BASE;
FLASH_KEYR    = FLASH_BASE + 0x04;
FLASH_OPTKEYR = FLASH_BASE + 0x08;
FLASH_SR      = FLASH_BASE + 0x0C;
FLASH_CR      = FLASH_BASE + 0x10;
FLASH_AR      = FLASH_BASE + 0x14;
FLASH_ORB     = FLASH_BASE + 0x1C;
FLASH_WRPR    = FLASH_BASE + 0x20;

CRC_BASE     = 0x40023000;
CRC_DR       = CRC_BASE;
CRC_IDR      = CRC_BASE + 0x04;
CRC_CR       = CRC_BASE + 0x08;
CRC_INIT     = CRC_BASE + 0x10;
CRC_POL      = CRC_BASE + 0x14;

PWR_BASE     = 0x40007000;
PWR_CR       = PWR_BASE;
PWR_CSR      = PWR_BASE + 0x04;

RCC_BASE     = 0x40021000;
RCC_CR       = RCC_BASE;
RCC_CFGR     = RCC_BASE + 0x04;
RCC_CIR      = RCC_BASE + 0x08;
RCC_APB2RSTR = RCC_BASE + 0x0C;
RCC_APB1RSTR = RCC_BASE + 0x10;
RCC_AHBENR   = RCC_BASE + 0x14;
RCC_APB2ENR  = RCC_BASE + 0x18;
RCC_APB1ENR  = RCC_BASE + 0x1C;
RCC_BDCR     = RCC_BASE + 0x20;
RCC_CSR      = RCC_BASE + 0x24;
RCC_AHBRSTR  = RCC_BASE + 0x28;
RCC_CFGR2    = RCC_BASE + 0x2C;
RCC_CFGR3    = RCC_BASE + 0x30;

GPIOA_BASE    = 0x48000000;
GPIOA_MODER   = GPIOA_BASE;
GPIOA_OTYPER  = GPIOA_BASE + 0x04;
GPIOA_OSPEEDR = GPIOA_BASE + 0x08;
GPIOA_PUPDR   = GPIOA_BASE + 0x0C;
GPIOA_IDR     = GPIOA_BASE + 0x10;
GPIOA_ODR     = GPIOA_BASE + 0x14;
GPIOA_BSRR    = GPIOA_BASE + 0x18;
GPIOA_LCKR    = GPIOA_BASE + 0x1C;
GPIOA_AFRL    = GPIOA_BASE + 0x20;
GPIOA_AFRH    = GPIOA_BASE + 0x24;
GPIOA_BRR     = GPIOA_BASE + 0x28;

GPIOB_BASE    = 0x48000400;
GPIOB_MODER   = GPIOB_BASE;
GPIOB_OTYPER  = GPIOB_BASE + 0x04;
GPIOB_OSPEEDR = GPIOB_BASE + 0x08;
GPIOB_PUPDR   = GPIOB_BASE + 0x0C;
GPIOB_IDR     = GPIOB_BASE + 0x10;
GPIOB_ODR     = GPIOB_BASE + 0x14;
GPIOB_BSRR    = GPIOB_BASE + 0x18;
GPIOB_LCKR    = GPIOB_BASE + 0x1C;
GPIOB_AFRL    = GPIOB_BASE + 0x20;
GPIOB_AFRH    = GPIOB_BASE + 0x24;
GPIOB_BRR     = GPIOB_BASE + 0x28;

GPIOC_BASE    = 0x48000800;
GPIOC_MODER   = GPIOC_BASE;
GPIOC_OTYPER  = GPIOC_BASE + 0x04;
GPIOC_OSPEEDR = GPIOC_BASE + 0x08;
GPIOC_PUPDR   = GPIOC_BASE + 0x0C;
GPIOC_IDR     = GPIOC_BASE + 0x10;
GPIOC_ODR     = GPIOC_BASE + 0x14;
GPIOC_BSRR    = GPIOC_BASE + 0x18;
GPIOC_AFRL    = GPIOC_BASE + 0x20;
GPIOC_AFRH    = GPIOC_BASE + 0x24;
GPIOC_BRR     = GPIOC_BASE + 0x28;

GPIOD_BASE    = 0x48000C00;
GPIOD_MODER   = GPIOD_BASE;
GPIOD_OTYPER  = GPIOD_BASE + 0x04;
GPIOD_OSPEEDR = GPIOD_BASE + 0x08;
GPIOD_PUPDR   = GPIOD_BASE + 0x0C;
GPIOD_IDR     = GPIOD_BASE + 0x10;
GPIOD_ODR     = GPIOD_BASE + 0x14;
GPIOD_BSRR    = GPIOD_BASE + 0x18;
GPIOD_LCKR    = GPIOD_BASE + 0x1C;
GPIOD_AFRL    = GPIOD_BASE + 0x20;
GPIOD_AFRH    = GPIOD_BASE + 0x24;
GPIOD_BRR     = GPIOD_BASE + 0x28;

GPIOE_BASE    = 0x48001000;
GPIOE_MODER   = GPIOE_BASE;
GPIOE_OTYPER  = GPIOE_BASE + 0x04;
GPIOE_OSPEEDR = GPIOE_BASE + 0x08;
GPIOE_PUPDR   = GPIOE_BASE + 0x0C;
GPIOE_IDR     = GPIOE_BASE + 0x10;
GPIOE_ODR     = GPIOE_BASE + 0x14;
GPIOE_BSRR    = GPIOE_BASE + 0x18;
GPIOE_AFRL    = GPIOE_BASE + 0x20;
GPIOE_AFRH    = GPIOE_BASE + 0x24;
GPIOE_BRR     = GPIOE_BASE + 0x28;

GPIOF_BASE    = 0x48001400;
GPIOF_MODER   = GPIOF_BASE;
GPIOF_OTYPER  = GPIOF_BASE + 0x04;
GPIOF_OSPEEDR = GPIOF_BASE + 0x08;
GPIOF_PUPDR   = GPIOF_BASE + 0x0C;
GPIOF_IDR     = GPIOF_BASE + 0x10;
GPIOF_ODR     = GPIOF_BASE + 0x14;
GPIOF_BSRR    = GPIOF_BASE + 0x18;
GPIOF_AFRL    = GPIOF_BASE + 0x20;
GPIOF_AFRH    = GPIOF_BASE + 0x24;
GPIOF_BRR     = GPIOF_BASE + 0x28;

DMA1_BASE    = 0x40020000;
DMA1_ISR     = DMA1_BASE;
DMA1_IFCR    = DMA1_BASE + 0x04;
DMA1_CHANNEL = DMA1_BASE + 0x08;

DMA2_BASE    = 0x40020400;
DMA2_ISR     = DMA2_BASE;
DMA2_IFCR    = DMA2_BASE + 0x04;
DMA2_CHANNEL = DMA2_BASE + 0x08;

SYSCFG_BASE    = 0x40010000;
SYSCFG_CFGR1   = SYSCFG_BASE;
SYSCFG_RCR     = SYSCFG_BASE + 0x04;
SYSCFG_EXTICR  = SYSCFG_BASE + 0x08;
SYSCFG_CFGR2   = SYSCFG_BASE + 0x18;

COMP_BASE      = 0x40010000;
COMP_CSR       = COMP_BASE + 0x1C;

OPAMP_BASE     = 0x40010000;
OPAMP_CSR      = OPAMP_BASE + 0x38;

EXTI_BASE    = 0x40010400;
EXTI_IMR1    = EXTI_BASE;
EXTI_EMR1    = EXTI_BASE + 0x04;
EXTI_RTSR1   = EXTI_BASE + 0x08;
EXTI_FTSR1   = EXTI_BASE + 0x0C;
EXTI_SWIER1  = EXTI_BASE + 0x10;
EXTI_PR1     = EXTI_BASE + 0x14;
EXTI_IMR2    = EXTI_BASE + 0x20;
EXTI_EMER2   = EXTI_BASE + 0x24;
EXTI_RTSR2   = EXTI_BASE + 0x28;
EXTI_FTSR2   = EXTI_BASE + 0x2C;
EXTI_SWIER2  = EXTI_BASE + 0x30;
EXTI_PR2     = EXTI_BASE + 0x34;

ADC1_BASE    = 0x50000000;
ADC1_ISR     = ADC1_BASE;
ADC1_IER     = ADC1_BASE + 0x04;
ADC1_CR      = ADC1_BASE + 0x08;
ADC1_CFGR    = ADC1_BASE + 0x0C;
ADC1_SMPR1   = ADC1_BASE + 0x14;
ADC1_SMPR2   = ADC1_BASE + 0x18;
ADC1_TR1     = ADC1_BASE + 0x20;
ADC1_TR2     = ADC1_BASE + 0x24;
ADC1_TR3     = ADC1_BASE + 0x28;
ADC1_SQR1    = ADC1_BASE + 0x30;
ADC1_SQR2    = ADC1_BASE + 0x34;
ADC1_SQR3    = ADC1_BASE + 0x38;
ADC1_SQR3    = ADC1_BASE + 0x3C;
ADC1_DR      = ADC1_BASE + 0x40;
ADC1_JSQR    = ADC1_BASE + 0x4C;
ADC1_OFR     = ADC1_BASE + 0x60;
ADC1_JDR     = ADC1_BASE + 0x80;
ADC1_AWD2CR  = ADC1_BASE + 0xA0;
ADC1_AWD3CR  = ADC1_BASE + 0xA4;
ADC1_DIFSEL  = ADC1_BASE + 0xB0;
DAC1_CALFACT = ADC1_BASE + 0xB4;

ADC2_BASE    = ADC1_BASE + 0x100;
ADC2_ISR     = ADC2_BASE;
ADC2_IER     = ADC2_BASE + 0x04;
ADC2_CR      = ADC2_BASE + 0x08;
ADC2_CFGR    = ADC2_BASE + 0x0C;
ADC2_SMPR1   = ADC2_BASE + 0x14;
ADC2_SMPR2   = ADC2_BASE + 0x18;
ADC2_TR1     = ADC2_BASE + 0x20;
ADC2_TR2     = ADC2_BASE + 0x24;
ADC2_TR3     = ADC2_BASE + 0x28;
ADC2_SQR1    = ADC2_BASE + 0x30;
ADC2_SQR2    = ADC2_BASE + 0x34;
ADC2_SQR3    = ADC2_BASE + 0x38;
ADC2_SQR3    = ADC2_BASE + 0x3C;
ADC2_DR      = ADC2_BASE + 0x40;
ADC2_JSQR    = ADC2_BASE + 0x4C;
ADC2_OFR     = ADC2_BASE + 0x60;
ADC2_JDR     = ADC2_BASE + 0x80;
ADC2_AWD2CR  = ADC2_BASE + 0xA0;
ADC2_AWD3CR  = ADC2_BASE + 0xA4;
ADC2_DIFSEL  = ADC2_BASE + 0xB0;

ADC12_BASE   = ADC1_BASE + 0x300;
ADC12_CSR    = ADC12_BASE;
ADC12_CCR    = ADC12_BASE + 0x08;
ADC12_CDR    = ADC12_BASE + 0x0C;

ADC3_BASE    = 0x50000400;
ADC3_ISR     = ADC3_BASE;
ADC3_IER     = ADC3_BASE + 0x04;
ADC3_CR      = ADC3_BASE + 0x08;
ADC3_CFGR    = ADC3_BASE + 0x0C;
ADC3_SMPR1   = ADC3_BASE + 0x14;
ADC3_SMPR2   = ADC3_BASE + 0x18;
ADC3_TR1     = ADC3_BASE + 0x20;
ADC3_TR2     = ADC3_BASE + 0x24;
ADC3_TR3     = ADC3_BASE + 0x28;
ADC3_SQR1    = ADC3_BASE + 0x30;
ADC3_SQR2    = ADC3_BASE + 0x34;
ADC3_SQR3    = ADC3_BASE + 0x38;
ADC3_SQR3    = ADC3_BASE + 0x3C;
ADC3_DR      = ADC3_BASE + 0x40;
ADC3_JSQR    = ADC3_BASE + 0x4C;
ADC3_OFR     = ADC3_BASE + 0x60;
ADC3_JDR     = ADC3_BASE + 0x80;
ADC3_AWD2CR  = ADC3_BASE + 0xA0;
ADC3_AWD3CR  = ADC3_BASE + 0xA4;
ADC3_DIFSEL  = ADC3_BASE + 0xB0;

ADC4_BASE    = ADC3_BASE + 0x100;
ADC4_ISR     = ADC4_BASE;
ADC4_IER     = ADC4_BASE + 0x04;
ADC4_CR      = ADC4_BASE + 0x08;
ADC4_CFGR    = ADC4_BASE + 0x0C;
ADC4_SMPR1   = ADC4_BASE + 0x14;
ADC4_SMPR2   = ADC4_BASE + 0x18;
ADC4_TR1     = ADC4_BASE + 0x20;
ADC4_TR2     = ADC4_BASE + 0x24;
ADC4_TR3     = ADC4_BASE + 0x28;
ADC4_SQR1    = ADC4_BASE + 0x30;
ADC4_SQR2    = ADC4_BASE + 0x34;
ADC4_SQR3    = ADC4_BASE + 0x38;
ADC4_SQR3    = ADC4_BASE + 0x3C;
ADC4_DR      = ADC4_BASE + 0x40;
ADC4_JSQR    = ADC4_BASE + 0x4C;
ADC4_OFR     = ADC4_BASE + 0x60;
ADC4_JDR     = ADC4_BASE + 0x80;
ADC4_AWD2CR  = ADC4_BASE + 0xA0;
ADC4_AWD3CR  = ADC4_BASE + 0xA4;
ADC4_DIFSEL  = ADC4_BASE + 0xB0;

ADC34_BASE   = ADC3_BASE + 0x300;
ADC34_CSR    = ADC34_BASE;
ADC34_CCR    = ADC34_BASE + 0x08;
ADC34_CDR    = ADC34_BASE + 0x0C;

DAC_BASE     = 0x40007400;
DAC_CR       = DAC_BASE;
DAC_SWTRIGR  = DAC_BASE + 0x04;
DAC_DHR12R1  = DAC_BASE + 0x08;
DAC_DHR12L1  = DAC_BASE + 0x0C;
DAC_DHR8R1   = DAC_BASE + 0x10;
DAC_DHR12R2  = DAC_BASE + 0x14;
DAC_DHR12L2  = DAC_BASE + 0x18;
DAC_DHR8R2   = DAC_BASE + 0x1C;
DAC_DHR12RD  = DAC_BASE + 0x20;
DAC_DHR12LD  = DAC_BASE + 0x24;
DAC_DHR8RD   = DAC_BASE + 0x28;
DAC_DOR1     = DAC_BASE + 0x2C;
DAC_DOR2     = DAC_BASE + 0x30;
DAC_SR       = DAC_BASE + 0x34;

TIM1_BASE  = 0x40012C00;
TIM1_CR1   = TIM1_BASE;
TIM1_CR2   = TIM1_BASE + 0x04;
TIM1_SMCR  = TIM1_BASE + 0x08;
TIM1_DIER  = TIM1_BASE + 0x0C;
TIM1_SR    = TIM1_BASE + 0x10;
TIM1_EGR   = TIM1_BASE + 0x14;
TIM1_CCMR1 = TIM1_BASE + 0x18;
TIM1_CCMR2 = TIM1_BASE + 0x1C;
TIM1_CCER  = TIM1_BASE + 0x20;
TIM1_CNT   = TIM1_BASE + 0x24;
TIM1_PSC   = TIM1_BASE + 0x28;
TIM1_ARR   = TIM1_BASE + 0x2C;
TIM1_RCR   = TIM1_BASE + 0x30;
TIM1_CCR1  = TIM1_BASE + 0x34;
TIM1_CCR2  = TIM1_BASE + 0x38;
TIM1_CCR3  = TIM1_BASE + 0x3C;
TIM1_CCR4  = TIM1_BASE + 0x40;
TIM1_BDTR  = TIM1_BASE + 0x44;
TIM1_DCR   = TIM1_BASE + 0x48;
TIM1_DMAR  = TIM1_BASE + 0x4C;
TIM1_CCMR3 = TIM1_BASE + 0x54;
TIM1_CCR5  = TIM1_BASE + 0x58;
TIM1_CCR6  = TIM1_BASE + 0x5C;
TIM1_OR    = TIM1_BASE + 0x60;

TIM8_BASE  = 0x40013400;
TIM8_CR1   = TIM8_BASE;
TIM8_CR2   = TIM8_BASE + 0x04;
TIM8_SMCR  = TIM8_BASE + 0x08;
TIM8_DIER  = TIM8_BASE + 0x0C;
TIM8_SR    = TIM8_BASE + 0x10;
TIM8_EGR   = TIM8_BASE + 0x14;
TIM8_CCMR1 = TIM8_BASE + 0x18;
TIM8_CCMR2 = TIM8_BASE + 0x1C;
TIM8_CCER  = TIM8_BASE + 0x20;
TIM8_CNT   = TIM8_BASE + 0x24;
TIM8_PSC   = TIM8_BASE + 0x28;
TIM8_ARR   = TIM8_BASE + 0x2C;
TIM8_RCR   = TIM8_BASE + 0x30;
TIM8_CCR1  = TIM8_BASE + 0x34;
TIM8_CCR2  = TIM8_BASE + 0x38;
TIM8_CCR3  = TIM8_BASE + 0x3C;
TIM8_CCR4  = TIM8_BASE + 0x40;
TIM8_BDTR  = TIM8_BASE + 0x44;
TIM8_DCR   = TIM8_BASE + 0x48;
TIM8_DMAR  = TIM8_BASE + 0x4C;
TIM8_CCMR3 = TIM8_BASE + 0x54;
TIM8_CCR5  = TIM8_BASE + 0x58;
TIM8_CCR6  = TIM8_BASE + 0x5C;
TIM8_OR    = TIM8_BASE + 0x60;

TIM2_BASE  = 0x40000000;
TIM2_CR1   = TIM2_BASE;
TIM2_CR2   = TIM2_BASE + 0x04;
TIM2_SMCR  = TIM2_BASE + 0x08;
TIM2_DIER  = TIM2_BASE + 0x0C;
TIM2_SR    = TIM2_BASE + 0x10;
TIM2_EGR   = TIM2_BASE + 0x14;
TIM2_CCMR1 = TIM2_BASE + 0x18;
TIM2_CCMR2 = TIM2_BASE + 0x1C;
TIM2_CCER  = TIM2_BASE + 0x20;
TIM2_CNT   = TIM2_BASE + 0x24;
TIM2_PSC   = TIM2_BASE + 0x28;
TIM2_ARR   = TIM2_BASE + 0x2C;
TIM2_CCR1  = TIM2_BASE + 0x34;
TIM2_CCR2  = TIM2_BASE + 0x38;
TIM2_CCR3  = TIM2_BASE + 0x3C;
TIM2_CCR4  = TIM2_BASE + 0x40;
TIM2_DRC   = TIM2_BASE + 0x48;
TIM2_DMAR  = TIM2_BASE + 0x4C;

TIM3_BASE  = 0x40000400;
TIM3_CR1   = TIM3_BASE;
TIM3_CR2   = TIM3_BASE + 0x04;
TIM3_SMCR  = TIM3_BASE + 0x08;
TIM3_DIER  = TIM3_BASE + 0x0C;
TIM3_SR    = TIM3_BASE + 0x10;
TIM3_EGR   = TIM3_BASE + 0x14;
TIM3_CCMR1 = TIM3_BASE + 0x18;
TIM3_CCMR2 = TIM3_BASE + 0x1C;
TIM3_CCER  = TIM3_BASE + 0x20;
TIM3_CNT   = TIM3_BASE + 0x24;
TIM3_PSC   = TIM3_BASE + 0x28;
TIM3_ARR   = TIM3_BASE + 0x2C;
TIM3_CCR1  = TIM3_BASE + 0x34;
TIM3_CCR2  = TIM3_BASE + 0x38;
TIM3_CCR3  = TIM3_BASE + 0x3C;
TIM3_CCR4  = TIM3_BASE + 0x40;
TIM3_DRC   = TIM3_BASE + 0x48;
TIM3_DMAR  = TIM3_BASE + 0x4C;

TIM4_BASE  = 0x40000800;
TIM4_CR1   = TIM4_BASE;
TIM4_CR2   = TIM4_BASE + 0x04;
TIM4_SMCR  = TIM4_BASE + 0x08;
TIM4_DIER  = TIM4_BASE + 0x0C;
TIM4_SR    = TIM4_BASE + 0x10;
TIM4_EGR   = TIM4_BASE + 0x14;
TIM4_CCMR1 = TIM4_BASE + 0x18;
TIM4_CCMR2 = TIM4_BASE + 0x1C;
TIM4_CCER  = TIM4_BASE + 0x20;
TIM4_CNT   = TIM4_BASE + 0x24;
TIM4_PSC   = TIM4_BASE + 0x28;
TIM4_ARR   = TIM4_BASE + 0x2C;
TIM4_CCR1  = TIM4_BASE + 0x34;
TIM4_CCR2  = TIM4_BASE + 0x38;
TIM4_CCR3  = TIM4_BASE + 0x3C;
TIM4_CCR4  = TIM4_BASE + 0x40;
TIM4_DRC   = TIM4_BASE + 0x48;
TIM4_DMAR  = TIM4_BASE + 0x4C;

TIM6_BASE = 0x40001000;
TIM6_CR1  = TIM6_BASE;
TIM6_CR2  = TIM6_BASE + 0x04;
TIM6_DIER = TIM6_BASE + 0x0C;
TIM6_SR   = TIM6_BASE + 0x10;
TIM6_EGR  = TIM6_BASE + 0x14;
TIM6_CNT  = TIM6_BASE + 0x24;
TIM6_PSC  = TIM6_BASE + 0x28;
TIM6_ARR  = TIM6_BASE + 0x2C;

TIM7_BASE = 0x40001400;
TIM7_CR1  = TIM7_BASE;
TIM7_CR2  = TIM7_BASE + 0x04;
TIM7_DIER = TIM7_BASE + 0x0C;
TIM7_SR   = TIM7_BASE + 0x10;
TIM7_EGR  = TIM7_BASE + 0x14;
TIM7_CNT  = TIM7_BASE + 0x24;
TIM7_PSC  = TIM7_BASE + 0x28;
TIM7_ARR  = TIM7_BASE + 0x2C;

TIM15_BASE  = 0x40014000;
TIM15_CR1   = TIM15_BASE;
TIM15_CR2   = TIM15_BASE + 0x04;
TIM15_SMCR  = TIM15_BASE + 0x08;
TIM15_DIER  = TIM15_BASE + 0x0C;
TIM15_SR    = TIM15_BASE + 0x10;
TIM15_EGR   = TIM15_BASE + 0x14;
TIM15_CCMR1 = TIM15_BASE + 0x18;
TIM15_CCER  = TIM15_BASE + 0x20;
TIM15_CNT   = TIM15_BASE + 0x24;
TIM15_PSC   = TIM15_BASE + 0x28;
TIM15_ARR   = TIM15_BASE + 0x2C;
TIM15_RCR   = TIM15_BASE + 0x30;
TIM15_CCR1  = TIM15_BASE + 0x34;
TIM15_CCR2  = TIM15_BASE + 0x38;
TIM15_BDTR  = TIM15_BASE + 0x44;
TIM15_DCR   = TIM15_BASE + 0x48;
TIM15_DMAR  = TIM15_BASE + 0x4C;

TIM16_BASE  = 0x40014400; 
TIM16_CR1   = TIM16_BASE;
TIM16_CR2   = TIM16_BASE + 0x04;
TIM16_DIER  = TIM16_BASE + 0x0C;
TIM16_SR    = TIM16_BASE + 0x10;
TIM16_EGR   = TIM16_BASE + 0x14;
TIM16_CCMR1 = TIM16_BASE + 0x18;
TIM16_CCER  = TIM16_BASE + 0x20;
TIM16_CNT   = TIM16_BASE + 0x24;
TIM16_PSC   = TIM16_BASE + 0x28;
TIM16_ARR   = TIM16_BASE + 0x2C;
TIM16_RCR   = TIM16_BASE + 0x30;
TIM16_CCR1  = TIM16_BASE + 0x34;
TIM16_BDTR  = TIM16_BASE + 0x44;
TIM16_DCR   = TIM16_BASE + 0x48;
TIM16_DMAR  = TIM16_BASE + 0x4C;
TIM16_OR    = TIM16_BASE + 0x50;

TIM17_BASE  = 0x40014800;
TIM17_CR1   = TIM17_BASE;
TIM17_CR2   = TIM17_BASE + 0x04;
TIM17_DIER  = TIM17_BASE + 0x0C;
TIM17_SR    = TIM17_BASE + 0x10;
TIM17_EGR   = TIM17_BASE + 0x14;
TIM17_CCMR1 = TIM17_BASE + 0x18;
TIM17_CCER  = TIM17_BASE + 0x20;
TIM17_CNT   = TIM17_BASE + 0x24;
TIM17_PSC   = TIM17_BASE + 0x28;
TIM17_ARR   = TIM17_BASE + 0x2C;
TIM17_RCR   = TIM17_BASE + 0x30;
TIM17_CCR1  = TIM17_BASE + 0x34;
TIM17_BDTR  = TIM17_BASE + 0x44;
TIM17_DCR   = TIM17_BASE + 0x48;
TIM17_DMAR  = TIM17_BASE + 0x4C;
TIM17_OR    = TIM17_BASE + 0x50;

IWDG_BASE = 0x40003000;
IWDG_KR   = IWDG_BASE;
IWDG_PR   = IWDG_BASE + 0x04;
IWDG_RLR  = IWDG_BASE + 0x08;
IWDG_SR   = IWDG_BASE + 0x0C;
IWDG_WINR = IWDG_BASE + 0x10;

WWDG_BASE = 0x40002C00;
WWDG_CR   = WWDG_BASE;
WWDG_CFR  = WWDG_BASE + 0x04;
WWDG_SR   = WWDG_BASE + 0x08;

RTC_BASE     = 0x40002800;
RTC_TR       = RTC_BASE;
RTC_DR       = RTC_BASE + 0x04;
RTC_CR       = RTC_BASE + 0x08;
RTC_ISR      = RTC_BASE + 0x0C;
RTC_PRER     = RTC_BASE + 0x10;
RTC_WUTR     = RTC_BASE + 0x14;
RTC_ALRMAR   = RTC_BASE + 0x1C;
RTC_ALRMBR   = RTC_BASE + 0x20;
RTC_WPR      = RTC_BASE + 0x24;
RTC_SSR      = RTC_BASE + 0x28;
RTC_SHIFTR   = RTC_BASE + 0x2C;
RTC_TSTR     = RTC_BASE + 0x30;
RTC_TSDR     = RTC_BASE + 0x34;
RTC_TSSSR    = RTC_BASE + 0x38;
RTC_CALR     = RTC_BASE + 0x3C;
RTC_TAFCR    = RTC_BASE + 0x40;
RTC_ALRMASSR = RTC_BASE + 0x44;
RTC_ALRMBSSR = RTC_BASE + 0x48;
RTC_BKP1R    = RTC_BASE + 0x50;
RTC_BKP2R    = RTC_BASE + 0x8C;

I2C1_BASE     = 0x40005400;
I2C1_CR1      = I2C1_BASE;
I2C1_CR2      = I2C1_BASE + 0x04;
I2C1_OAR1     = I2C1_BASE + 0x08;
I2C1_OAR2     = I2C1_BASE + 0x0C;
I2C1_TIMINGR  = I2C1_BASE + 0x10;
I2C1_TIMEOUTR = I2C1_BASE + 0x14;
I2C1_ISR      = I2C1_BASE + 0x18;
I2C1_ICR      = I2C1_BASE + 0x1C;
I2C1_PECR     = I2C1_BASE + 0x20;
I2C1_RXDR     = I2C1_BASE + 0x24;
I2C1_TXDR     = I2C1_BASE + 0x28;

I2C2_BASE     = 0x40005800;
I2C2_CR1      = I2C2_BASE;
I2C2_CR2      = I2C2_BASE + 0x04;
I2C2_OAR1     = I2C2_BASE + 0x08;
I2C2_OAR2     = I2C2_BASE + 0x0C;
I2C2_TIMINGR  = I2C2_BASE + 0x10;
I2C2_TIMEOUTR = I2C2_BASE + 0x14;
I2C2_ISR      = I2C2_BASE + 0x18;
I2C2_ICR      = I2C2_BASE + 0x1C;
I2C2_PECR     = I2C2_BASE + 0x20;
I2C2_RXDR     = I2C2_BASE + 0x24;
I2C2_TXDR     = I2C2_BASE + 0x28;

I2S2_BASE     = 0x40003800;
I2S2_CR1      = I2S2_BASE;
I2S2_CR2      = I2S2_BASE + 0x04;
I2S2_OAR1     = I2S2_BASE + 0x08;
I2S2_OAR2     = I2S2_BASE + 0x0C;
I2S2_TIMINGR  = I2S2_BASE + 0x10;
I2S2_TIMEOUTR = I2S2_BASE + 0x14;
I2S2_ISR      = I2S2_BASE + 0x18;
I2S2_ICR      = I2S2_BASE + 0x1C;
I2S2_PECR     = I2S2_BASE + 0x20;
I2S2_RXDR     = I2S2_BASE + 0x24;
I2S2_TXDR     = I2S2_BASE + 0x28;

I2S2EXT_BASE     = 0x40003400;
I2S2EXT_CR1      = I2S2EXT_BASE;
I2S2EXT_CR2      = I2S2EXT_BASE + 0x04;
I2S2EXT_OAR1     = I2S2EXT_BASE + 0x08;
I2S2EXT_OAR2     = I2S2EXT_BASE + 0x0C;
I2S2EXT_TIMINGR  = I2S2EXT_BASE + 0x10;
I2S2EXT_TIMEOUTR = I2S2EXT_BASE + 0x14;
I2S2EXT_ISR      = I2S2EXT_BASE + 0x18;
I2S2EXT_ICR      = I2S2EXT_BASE + 0x1C;
I2S2EXT_PECR     = I2S2EXT_BASE + 0x20;
I2S2EXT_RXDR     = I2S2EXT_BASE + 0x24;
I2S2EXT_TXDR     = I2S2EXT_BASE + 0x28;

I2S3_BASE     = 0x40003C00;
I2S3_CR1      = I2S3_BASE;
I2S3_CR2      = I2S3_BASE + 0x04;
I2S3_OAR1     = I2S3_BASE + 0x08;
I2S3_OAR2     = I2S3_BASE + 0x0C;
I2S3_TIMINGR  = I2S3_BASE + 0x10;
I2S3_TIMEOUTR = I2S3_BASE + 0x14;
I2S3_ISR      = I2S3_BASE + 0x18;
I2S3_ICR      = I2S3_BASE + 0x1C;
I2S3_PECR     = I2S3_BASE + 0x20;
I2S3_RXDR     = I2S3_BASE + 0x24;
I2S3_TXDR     = I2S3_BASE + 0x28;

I2S3EXT_BASE     = 0x40004000;
I2S3EXT_CR1      = I2S3EXT_BASE;
I2S3EXT_CR2      = I2S3EXT_BASE + 0x04;
I2S3EXT_OAR1     = I2S3EXT_BASE + 0x08;
I2S3EXT_OAR2     = I2S3EXT_BASE + 0x0C;
I2S3EXT_TIMINGR  = I2S3EXT_BASE + 0x10;
I2S3EXT_TIMEOUTR = I2S3EXT_BASE + 0x14;
I2S3EXT_ISR      = I2S3EXT_BASE + 0x18;
I2S3EXT_ICR      = I2S3EXT_BASE + 0x1C;
I2S3EXT_PECR     = I2S3EXT_BASE + 0x20;
I2S3EXT_RXDR     = I2S3EXT_BASE + 0x24;
I2S3EXT_TXDR     = I2S3EXT_BASE + 0x28;

SPI1_BASE    = 0x40013000;
SPI1_CR1     = SPI1_BASE;
SPI1_CR2     = SPI1_BASE + 0x04;
SPI1_SR      = SPI1_BASE + 0x08;
SPI1_DR      = SPI1_BASE + 0x0C;
SPI1_CRCPR   = SPI1_BASE + 0x10;
SPI1_RXCRCR  = SPI1_BASE + 0x14;
SPI1_TXCRCR  = SPI1_BASE + 0x18;
SPI1_I2SCFGR = SPI1_BASE + 0x1C;
SPI1_I2SPR   = SPI1_BASE + 0x20;

SPI2_BASE    = 0x40003800;
SPI2_CR1     = SPI2_BASE;
SPI2_CR2     = SPI2_BASE + 0x04;
SPI2_SR      = SPI2_BASE + 0x08;
SPI2_DR      = SPI2_BASE + 0x0C;
SPI2_CRCPR   = SPI2_BASE + 0x10;
SPI2_RXCRCR  = SPI2_BASE + 0x14;
SPI2_TXCRCR  = SPI2_BASE + 0x18;
SPI2_I2SCFGR = SPI2_BASE + 0x1C;
SPI2_I2SPR   = SPI2_BASE + 0x20;

SPI3_BASE    = 0x40003C00;
SPI3_CR1     = SPI3_BASE;
SPI3_CR2     = SPI3_BASE + 0x04;
SPI3_SR      = SPI3_BASE + 0x08;
SPI3_DR      = SPI3_BASE + 0x0C;
SPI3_CRCPR   = SPI3_BASE + 0x10;
SPI3_RXCRCR  = SPI3_BASE + 0x14;
SPI3_TXCRCR  = SPI3_BASE + 0x18;
SPI3_I2SCFGR = SPI3_BASE + 0x1C;
SPI3_I2SPR   = SPI3_BASE + 0x20;

USART1_BASE = 0x40013800;
USART1_CR1  = USART1_BASE;
USART1_CR2  = USART1_BASE + 0x04;
USART1_CR3  = USART1_BASE + 0x08;
USART1_BRR  = USART1_BASE + 0x0C;
USART1_GTPR = USART1_BASE + 0x10;
USART1_RTOR = USART1_BASE + 0x14;
USART1_RQR  = USART1_BASE + 0x18;
USART1_ISR  = USART1_BASE + 0x1C;
USART1_ICR  = USART1_BASE + 0x20;
USART1_RDR  = USART1_BASE + 0x24;
USART1_TDR  = USART1_BASE + 0x28;

USART2_BASE = 0x40004400;
USART2_CR1  = USART2_BASE;
USART2_CR2  = USART2_BASE + 0x04;
USART2_CR3  = USART2_BASE + 0x08;
USART2_BRR  = USART2_BASE + 0x0C;
USART2_GTPR = USART2_BASE + 0x10;
USART2_RTOR = USART2_BASE + 0x14;
USART2_RQR  = USART2_BASE + 0x18;
USART2_ISR  = USART2_BASE + 0x1C;
USART2_ICR  = USART2_BASE + 0x20;
USART2_RDR  = USART2_BASE + 0x24;
USART2_TDR  = USART2_BASE + 0x28;

USART3_BASE     = 0x40004800;
USART3_CR1  = USART3_BASE;
USART3_CR2  = USART3_BASE + 0x04;
USART3_CR3  = USART3_BASE + 0x08;
USART3_BRR  = USART3_BASE + 0x0C;
USART3_GTPR = USART3_BASE + 0x10;
USART3_RTOR = USART3_BASE + 0x14;
USART3_RQR  = USART3_BASE + 0x18;
USART3_ISR  = USART3_BASE + 0x1C;
USART3_ICR  = USART3_BASE + 0x20;
USART3_RDR  = USART3_BASE + 0x24;
USART3_TDR  = USART3_BASE + 0x28;

UART4_BASE = 0x40004C00;
UART4_CR1  = UART4_BASE;
UART4_CR2  = UART4_BASE + 0x04;
UART4_CR3  = UART4_BASE + 0x08;
UART4_BRR  = UART4_BASE + 0x0C;
UART4_GTPR = UART4_BASE + 0x10;
UART4_RTOR = UART4_BASE + 0x14;
UART4_RQR  = UART4_BASE + 0x18;
UART4_ISR  = UART4_BASE + 0x1C;
UART4_ICR  = UART4_BASE + 0x20;
UART4_RDR  = UART4_BASE + 0x24;
UART4_TDR  = UART4_BASE + 0x28;

UART5_BASE = 0x40005000;
UART5_CR1  = UART5_BASE;
UART5_CR2  = UART5_BASE + 0x04;
UART5_CR3  = UART5_BASE + 0x08;
UART5_BRR  = UART5_BASE + 0x0C;
UART5_GTPR = UART5_BASE + 0x10;
UART5_RTOR = UART5_BASE + 0x14;
UART5_RQR  = UART5_BASE + 0x18;
UART5_ISR  = UART5_BASE + 0x1C;
UART5_ICR  = UART5_BASE + 0x20;
UART5_RDR  = UART5_BASE + 0x24;
UART5_TDR  = UART5_BASE + 0x28;

TSC_BASE   = 0x40024000;
TSC_CR     = TSC_BASE;
TSC_IER    = TSC_BASE + 0x04;
TSC_ICR    = TSC_BASE + 0x08;
TSC_ISR    = TSC_BASE + 0x0C;
TSC_IOHCR  = TSC_BASE + 0x10;
TSC_IOASCR = TSC_BASE + 0x18;
TSC_IOSCR  = TSC_BASE + 0x20;
TSC_IOCCR  = TSC_BASE + 0x28;
TSC_IOGCSR = TSC_BASE + 0x30;
TSC_IOG1CR = TSC_BASE + 0x30 + 4 * 1;
TSC_IOG2CR = TSC_BASE + 0x30 + 4 * 2;
TSC_IOG3CR = TSC_BASE + 0x30 + 4 * 3;
TSC_IOG4CR = TSC_BASE + 0x30 + 4 * 4;
TSC_IOG5CR = TSC_BASE + 0x30 + 4 * 5;
TSC_IOG6CR = TSC_BASE + 0x30 + 4 * 6;
TSC_IOG7CR = TSC_BASE + 0x30 + 4 * 7;
TSC_IOG8CR = TSC_BASE + 0x30 + 4 * 8;

CAN_BASE    = 0x40006400;
CAN_MCR     = CAN_BASE;
CAN_MSR     = CAN_BASE + 0x04;
CAN_TSR     = CAN_BASE + 0x08;
CAN_RF0R    = CAN_BASE + 0x0C;
CAN_RF1R    = CAN_BASE + 0x10;
CAN_IER     = CAN_BASE + 0x14;
CAN_ESR     = CAN_BASE + 0x18;
CAN_BTR     = CAN_BASE + 0x1C;
CAN_MAILBOX = CAN_BASE + 0x180;
CAN_FIFO    = CAN_BASE + 0x1B0;
CAN_FMR     = CAN_BASE + 0x200;
CAN_FM1R    = CAN_BASE + 0x204;
CAN_FS1R    = CAN_BASE + 0x20C;
CAN_FFA1R   = CAN_BASE + 0x214;
CAN_FA1R    = CAN_BASE + 0x21C;
CAN_FILTER  = CAN_BASE + 0x240;

USB_BASE   = 0x40005C00;
USB_EPR    = USB_BASE;
USB_CNTR   = USB_BASE + 0x40;
USB_ISTR   = USB_BASE + 0x44;
USB_FNR    = USB_BASE + 0x48;
USB_DADDR  = USB_BASE + 0x4C;
USB_BTABLE = USB_BASE + 0x50;

USB_SRAM_BASE = 0x40006000;
